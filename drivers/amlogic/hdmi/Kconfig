## drivers/amlogic/hdmi/Kconfig
```kconfig
menu "Amlogic HDMI TX Support"


config AML_HDMI_TX
        bool "HDMI Output Enable"
        default y
        select SWITCH
        select AM_DISPLAY_MODULE
        help  
                hdmi output enable,It should be enalbe if board have hdmi out interface

if AML_HDMI_TX
config AML_HDMI_TX_HDCP
        tristate "HDMI TX HDCP Enable"
        default n
        help  
                hdmitx hdcp enable,It should be enalbe if board have hdmitx hdcp key
endif        
endmenu
```
